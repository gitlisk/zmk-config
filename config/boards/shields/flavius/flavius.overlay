/ {
    chosen {
        zmk,kscan = &kscan0;
    };

    kscan0: kscan {
        compatible = "zmk,kscan-gpio-direct";
        label = "kscan0";
        input-gpios = 
            <&pro_micro0 17 (GPIO_ACTIVE_HIGH | GPIO_PULL_DOWN)>,
            <&pro_micro0 20 (GPIO_ACTIVE_HIGH | GPIO_PULL_DOWN)>;
    };
};