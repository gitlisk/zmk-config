#include "flavius.dtsi" // Notice that the main dtsi files are included in the overlay.

&default_transform { // The matrix transform for this board is 6 columns over because the left half is 6 columns wide according to the matrix.
  col-offset = <4>;
};

&kscan0 {
    col-gpios
        = <&pro_micro 6 GPIO_ACTIVE_HIGH>,
          <&pro_micro 7 GPIO_ACTIVE_HIGH>,
          <&pro_micro 8 GPIO_ACTIVE_HIGH>,
          <&pro_micro 9 GPIO_ACTIVE_HIGH>;
};