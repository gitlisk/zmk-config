## config/boards/shields/flavius/Kconfig.defconfig
```kconfig
if SHIELD_FLAVIUS_LEFT

config ZMK_KEYBOARD_NAME
    default "flavius"

config ZMK_SPLIT_ROLE_CENTRAL
    default y

endif

if SHIELD_FLAVIUS_LEFT || SHIELD_FLAVIUS_RIGHT

config ZMK_SPLIT
    default y

endif
```

## config/boards/shields/flavius/Kconfig.shield
```kconfig
config SHIELD_FLAVIUS_LEFT
    def_bool $(shields_list_contains,flavius_left)

config SHIELD_FLAVIUS_RIGHT
    def_bool $(shields_list_contains,flavius_right)
```
